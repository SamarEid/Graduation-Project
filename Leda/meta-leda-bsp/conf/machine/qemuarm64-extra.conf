## Leda/meta-leda-bsp/conf/machine/qemuarm64-extra.conf
```bitbake
#@TYPE: Machine
#@NAME: qemuarm64 machine
#@DESCRIPTION: Reference machine configuration for qemu arm64

require conf/machine/common-qemu-arm.inc

WKS_FILES = "qemuarm64.wks"
UBOOT_MACHINE = "qemu_arm64_defconfig"
# # Path to RAUC private key and certificate (for signing update bundles)
# RAUC_KEY_FILE ?= "/home/rehab/ledafull/meta-leda/rauc-keys/rauc.key"
# RAUC_CERT_FILE ?= "/home/rehab/ledafull/meta-leda/rauc-keys/rauc.cert"
ROOTFS_POSTPROCESS_COMMAND += "install_rcS_default;"
```
